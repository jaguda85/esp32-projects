// ===================================================================================
// CZĘŚĆ 1: PREAMBUŁA, DEFINICJE GLOBALNE I DEKLARACJE
// ===================================================================================

#include <SPI.h>
#include <Adafruit_GFX.h>
#include <Adafruit_ILI9341.h>
#include <SD.h>
#include <EEPROM.h>

// --- Definicje pinów ---
#define TFT_CS   5
#define TFT_DC   4
#define TFT_RST  22
#define TFT_MOSI 23
#define TFT_CLK  18
#define TFT_MISO 19
#define SD_CS    15

#define POT_GAZ      35
#define POT_SPRZEGLO 34

#define LED_ZIELONY  26

#define PRZYCISK_GORA   32
#define PRZYCISK_DOL    33
#define PRZYCISK_LEWO   12
#define PRZYCISK_PRAWO  14
#define PRZYCISK_OK     21
#define PRZYCISK_START  27 // Stary SET
#define PRZYCISK_SET    13 // Stary START

// Inicjalizacja wyświetlacza
Adafruit_ILI9341 tft = Adafruit_ILI9341(TFT_CS, TFT_DC, TFT_RST);

// --- Zmienne globalne i struktury ---
bool poprzedniStanGora = HIGH, poprzedniStanDol = HIGH, poprzedniStanLewo = HIGH, poprzedniStanPrawo = HIGH, poprzedniStanOK = HIGH, poprzedniStanSet = HIGH, poprzedniStanStart = HIGH;
unsigned long czasOstatniegoNacisniecia = 0;
const unsigned long OPOZNIENIE_PRZYCISKOW = 200;
const unsigned long OPOZNIENIE_PRZED_PRZEWIJANIEM = 200;
const unsigned long SZYBKOSC_PRZEWIJANIA_ZNAKOW = 80;

struct Ustawienia {
  uint16_t gazMin = 0;
  uint16_t gazMax = 4095;
  uint8_t sprzegloPuszczoneProc = 10;
  uint8_t sprzegloWcisnieteProc = 90;
  bool gazOdwracany = false;
  bool sprzegloOdwracane = false;
  uint16_t ledMinTime = 2000;
  uint16_t ledMaxTime = 6000;
  uint8_t screenRotation = 1;
};
Ustawienia ustawienia;
const int EEPROM_ADRES_USTAWIEN = 0;

int wartoscGazu = 0, wartoscSprzegla = 0;

#define MAX_ZAWODNIKOW 50
#define MAX_DLUGOSC_NICKU 10
String aktualnyZawodnik = "GOSC";
String listaZawodnikow[MAX_ZAWODNIKOW];
int liczbaZawodnikow = 0;
String nazwaPlikuZawodnikow = "/zawodnicy.txt";
const char DOSTEPNE_ZNAKI[] = " ABCDEFGHIJKLMNOPQRSTUVWXYZ0123456789";
const int LICZBA_ZNAKOW = sizeof(DOSTEPNE_ZNAKI) - 1;

// --- Zmienne do obsługi menu ---
int pozycjaMenu = 0;
int pozycjaKursora = 0;
char wybranyZnak = ' ';
String nowyNick = "";
int indeksZnaku = 0;
int poprzedniaPozycjaMenu = -1; // Używane do optymalizacji rysowania menu
bool wymusPelneRysowanie = true;
bool wymusZaktualizowanieMenu = false; // NOWA FLAGA: wymusza aktualizację tylko menu
int pozycjaPrzewijania = 0;
const int WIERSZY_LISTY_ZAWODNIKOW = 7;
const int WIERSZY_NA_EKRANIE = 10;
int indeksZawodnikaDoUsuniecia = -1;
int pozycjaMenuPotwierdzenia = 0;
unsigned long czasOstatniegoMigniecia = 0;
bool stanMigniecia = false;
bool trybEdycjiUstawien = false;

// --- Tryby pracy programu ---
#define TRYB_POWITALNY 0
#define TRYB_TEST 1
#define TRYB_REKORDY 2
#define TRYB_MENU_ZAWODNIKA 3
#define TRYB_WYBOR_ZAWODNIKA 4
#define TRYB_DODAJ_ZAWODNIKA 5
#define TRYB_DIAGNOSTYKA_LIVE 6
#define TRYB_REKORDY_POTWIERDZENIE_USUNIECIA 7
#define TRYB_USUN_ZAWODNIKA 8
#define TRYB_USUN_ZAWODNIKA_POTWIERDZENIE 9
#define TRYB_DIAGNOSTYKA_MENU 10
#define TRYB_DIAGNOSTYKA_PROGI 11
#define TRYB_USUN_WYNIKI_GOSCIA 12
#define TRYB_USUN_WYNIKI_GOSCIA_POTWIERDZENIE 13

int tryb = TRYB_POWITALNY;
int stanTestu = 0;
unsigned long czasStartu = 0, czasReakcji = 0, czasFazy = 0;
int procentGazuWyniku = 0;

// --- Zmienne dla karty SD i wyników ---
bool sdDostepna = false;
int numerTestu = 0;
String nazwaPlikuWynikow = "/wyniki.csv";
unsigned long najlepszyWynik = 9999;
String najlepszyZawodnik = "---";
struct Wynik { String nick; unsigned long czas; };
const int MAX_WYNIKOW = 500;
Wynik wyniki[MAX_WYNIKOW];
int liczbaWynikow = 0;

// --- Zmienne do obsługi przytrzymania przycisków ---
unsigned long czasOstatniegoPrzewiniecia = 0;
const unsigned long CZAS_PIERWSZEGO_PRZEWINIECIA = 500;
const unsigned long CZAS_KOLEJNYCH_PRZEWINIEC = 100;

// --- Zmienne dla suwaków ---
int poprzedniGaz = -1;
int poprzednieSprzeglo = -1;
int poprzedniGazTest = -1;
int poprzednieSprzegloTest = -1;

// Tutaj wklej swoją bitmapę
//const unsigned char zuzel[] PROGMEM = { /* ... tu wklej swoją bitmape 320x240px ... */
// 'zuzelSmile', 320x240px
const unsigned char epd_bitmap_zuzelSmile [] PROGMEM = {
	0xff, 0xff, 0xff, 0xff, 0xff, 0xff, 0xff, 0xff, 0xff, 0xff, 0xff, 0xff, 0xff, 0xff, 0xff, 0xff, 
	0xff, 0xff, 0xff, 0xff, 0xff, 0xff, 0xff, 0xff, 0xff, 0xff, 0xff, 0xff, 0xf0, 0x00, 0xff, 0xff, 
	0xff, 0xff, 0xff, 0xff, 0xff, 0xff, 0xff, 0xff, 0xff, 0xff, 0xff, 0xff, 0xff, 0xff, 0xff, 0xff, 
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	0xff, 0xff, 0xff, 0xff, 0xff, 0xff, 0xff, 0xff, 0xff, 0xff, 0xff, 0xff, 0xff, 0xff, 0xff, 0xff
};

// Array of all bitmaps for convenience. (Total bytes used to store images in PROGMEM = 9616)
//const int epd_bitmap_allArray_LEN = 1;
//const unsigned char* epd_bitmap_allArray[1] = {
//	epd_bitmap_zuzelSmile
//};

// };

// --- Deklaracje funkcji ---
void rysujEkranPowitalny();
void wyswietlEkranRekordow();
void odczytajPosortujIWyswietlRekordy();
void usunWszystkieRekordy();
void wyswietlPotwierdzenieUsuniecia();
void wyswietlEkranDiagnostykiLive();
void aktualizujPasekProcentowy(int y, int procent, uint16_t kolor, int &poprzedniProcent, int x = 20, int w = 280, int h = 30);
void wyswietlMenuZawodnika();
void wyswietlListeZawodnikow();
void wyswietlListeDoUsuniecia();
void usunZawodnika(int);
void wyswietlPotwierdzenieUsunieciaZawodnika();
void odczytajNajlepszyWynik();
void obslugaMenuOK();
void obslugaTestu();
void obslugaPrzewijaniaRekordow(int);
void wczytajUstawienia();
void zapiszUstawienia();
void wyswietlMenuDiagnostyki();
void wyswietlUstawieniaProgow();
void obslugaMenuDiagnostyki(int);
void obslugaUstawienProgow(int);
bool inicjujKarteSD();
void zapiszWynik(unsigned long, int, String);
void wczytajZawodnikow();
void zapiszNowegoZawodnika(String);
void obslugaMenuNawigacjaPozioma(int);
void obslugaMenuNawigacja(int);
void wyswietlDodawanieZawodnika(String, int, char);
void obslugaMruganiaNicku();
void wyswietlLogoStartowe();
void rysujSuwakiTestu(int pG, int pS);
void rysujTlo();
void usunWynikiGoscia();
void wyswietlPotwierdzenieUsunieciaGoscia();
void aktualizujEkranDiagnostyki(int pG, int pS);
void aktualizujSuwakiTestu(int pG, int pS);
void wyswietlInfoTestu(String info);
// ===================================================================================
// CZĘŚĆ 2: GŁÓWNE FUNKCJE SETUP() I LOOP()
// ===================================================================================

void setup() {
  Serial.begin(115200);
  tft.begin();
  EEPROM.begin(2048);
  
  wczytajUstawienia();
  tft.setRotation(ustawienia.screenRotation);

  pinMode(LED_ZIELONY, OUTPUT);
  pinMode(PRZYCISK_GORA, INPUT_PULLUP);
  pinMode(PRZYCISK_DOL, INPUT_PULLUP);
  pinMode(PRZYCISK_LEWO, INPUT_PULLUP);
  pinMode(PRZYCISK_PRAWO, INPUT_PULLUP);
  pinMode(PRZYCISK_OK, INPUT_PULLUP);
  pinMode(PRZYCISK_SET, INPUT_PULLUP);
  pinMode(PRZYCISK_START, INPUT_PULLUP);

  digitalWrite(LED_ZIELONY, LOW);
  
  sdDostepna = inicjujKarteSD();
  if (sdDostepna) {
    wczytajZawodnikow();
    odczytajNajlepszyWynik();
  }
  
  wyswietlLogoStartowe();
  randomSeed(analogRead(39));
  rysujEkranPowitalny();
}

void loop() {
  unsigned long teraz = millis();
  bool stanGora = digitalRead(PRZYCISK_GORA);
  bool stanDol = digitalRead(PRZYCISK_DOL);
  bool stanLewo = digitalRead(PRZYCISK_LEWO);
  bool stanPrawo = digitalRead(PRZYCISK_PRAWO);
  bool stanOK = digitalRead(PRZYCISK_OK);
  bool stanSet = digitalRead(PRZYCISK_SET);
  bool stanStart = digitalRead(PRZYCISK_START);

  if (teraz - czasOstatniegoNacisniecia > OPOZNIENIE_PRZYCISKOW) {
    // START
    if (stanStart == LOW && poprzedniStanStart == HIGH) {
      czasOstatniegoNacisniecia = teraz;
      if (tryb == TRYB_POWITALNY) {
        tryb = TRYB_TEST;
        stanTestu = 0; 
        wymusPelneRysowanie = true;
      } else if (tryb == TRYB_TEST && (stanTestu == 3 || stanTestu == 4)) {
        tryb = TRYB_POWITALNY;
        rysujEkranPowitalny();
      } else if (tryb == TRYB_DODAJ_ZAWODNIKA) {
        if (pozycjaKursora < MAX_DLUGOSC_NICKU) {
          if (nowyNick.length()<=pozycjaKursora) nowyNick+=wybranyZnak; else nowyNick.setCharAt(pozycjaKursora, wybranyZnak);
        }
        nowyNick.trim(); 
        if(nowyNick.length()>0) { zapiszNowegoZawodnika(nowyNick); aktualnyZawodnik=nowyNick; }
        tryb=TRYB_POWITALNY;
        rysujEkranPowitalny();
      }
    }
    // SET -> COFNIJ
    if (stanSet == LOW && poprzedniStanSet == HIGH) {
      czasOstatniegoNacisniecia = teraz;
      wymusPelneRysowanie = true;
      trybEdycjiUstawien = false;
      switch(tryb) {
        case TRYB_POWITALNY: tryb = TRYB_DIAGNOSTYKA_MENU; pozycjaMenu = 0; wyswietlMenuDiagnostyki(); break;
        case TRYB_TEST: tryb = TRYB_POWITALNY; digitalWrite(LED_ZIELONY, LOW); rysujEkranPowitalny(); break;
        case TRYB_MENU_ZAWODNIKA:
        case TRYB_REKORDY:
        case TRYB_DIAGNOSTYKA_MENU: tryb = TRYB_POWITALNY; rysujEkranPowitalny(); break;
        case TRYB_WYBOR_ZAWODNIKA:
        case TRYB_DODAJ_ZAWODNIKA:
        case TRYB_USUN_ZAWODNIKA: tryb = TRYB_MENU_ZAWODNIKA; pozycjaMenu = 0; wyswietlMenuZawodnika(); break;
        case TRYB_DIAGNOSTYKA_LIVE:
        case TRYB_DIAGNOSTYKA_PROGI: tryb = TRYB_DIAGNOSTYKA_MENU; pozycjaMenu = 0; wyswietlMenuDiagnostyki(); break;
        case TRYB_REKORDY_POTWIERDZENIE_USUNIECIA: tryb = TRYB_REKORDY; wyswietlEkranRekordow(); break;
        case TRYB_USUN_ZAWODNIKA_POTWIERDZENIE: tryb = TRYB_USUN_ZAWODNIKA; wyswietlListeDoUsuniecia(); break;
        case TRYB_USUN_WYNIKI_GOSCIA_POTWIERDZENIE: tryb = TRYB_REKORDY; wyswietlEkranRekordow(); break;
      }
    }
    // OK
    if (stanOK == LOW && poprzedniStanOK == HIGH) {
      czasOstatniegoNacisniecia = teraz;
      if (tryb == TRYB_POWITALNY) {
        wymusPelneRysowanie = true; tryb = TRYB_MENU_ZAWODNIKA; pozycjaMenu = 0; wyswietlMenuZawodnika();
      } else {
        obslugaMenuOK();
      }
    }
    // NAWIGACJA
    if (stanGora == LOW && poprzedniStanGora == HIGH) {
      czasOstatniegoNacisniecia = teraz;
      if (tryb == TRYB_REKORDY) { obslugaPrzewijaniaRekordow(-1); }
      else if (tryb == TRYB_DIAGNOSTYKA_MENU) { obslugaMenuDiagnostyki(-1); }
      else if (tryb == TRYB_DIAGNOSTYKA_PROGI) { obslugaUstawienProgow(trybEdycjiUstawien ? 100 : -1); }
      else { obslugaMenuNawigacja(-1); }
    }
    if (stanDol == LOW && poprzedniStanDol == HIGH) {
      czasOstatniegoNacisniecia = teraz;
      if(tryb == TRYB_REKORDY) { obslugaPrzewijaniaRekordow(1); }
      else if (tryb == TRYB_DIAGNOSTYKA_MENU) { obslugaMenuDiagnostyki(1); }
      else if (tryb == TRYB_DIAGNOSTYKA_PROGI) { obslugaUstawienProgow(trybEdycjiUstawien ? -100 : 1); }
      else { obslugaMenuNawigacja(1); }
    }
    if (stanLewo == LOW && poprzedniStanLewo == HIGH) {
      czasOstatniegoNacisniecia = teraz;
      if (tryb == TRYB_POWITALNY) { tryb = TRYB_REKORDY; pozycjaPrzewijania = 0; wymusPelneRysowanie = true; wyswietlEkranRekordow(); } 
      else if (tryb == TRYB_DIAGNOSTYKA_PROGI) { if(trybEdycjiUstawien) obslugaUstawienProgow(-10); }
      else { obslugaMenuNawigacjaPozioma(-1); }
    }
    if (stanPrawo == LOW && poprzedniStanPrawo == HIGH) {
      czasOstatniegoNacisniecia = teraz;
      if (tryb == TRYB_DIAGNOSTYKA_PROGI) { if(trybEdycjiUstawien) obslugaUstawienProgow(10); }
      else { obslugaMenuNawigacjaPozioma(1); }
    }
  }

  if (tryb == TRYB_DODAJ_ZAWODNIKA) {
    if ((stanLewo == LOW || stanPrawo == LOW) && (teraz - czasOstatniegoNacisniecia > OPOZNIENIE_PRZED_PRZEWIJANIEM)) {
      if (teraz - czasOstatniegoNacisniecia > SZYBKOSC_PRZEWIJANIA_ZNAKOW) {
        if (stanLewo == LOW) obslugaMenuNawigacjaPozioma(-1); else if (stanPrawo == LOW) obslugaMenuNawigacjaPozioma(1);
        czasOstatniegoNacisniecia = teraz;
      }
    }
  }
  
  poprzedniStanGora = stanGora; poprzedniStanDol = stanDol; poprzedniStanLewo = stanLewo;
  poprzedniStanPrawo = stanPrawo; poprzedniStanOK = stanOK; poprzedniStanSet = stanSet;
  poprzedniStanStart = stanStart;
  
  if (tryb == TRYB_TEST) { obslugaTestu(); } 
  else if (tryb == TRYB_DIAGNOSTYKA_LIVE) {
    if(wymusPelneRysowanie) {
      wyswietlEkranDiagnostykiLive();
      wymusPelneRysowanie = false;
    }
    wartoscGazu = analogRead(POT_GAZ);
    int procentGazu = map(wartoscGazu, ustawienia.gazMin, ustawienia.gazMax, ustawienia.gazOdwracany ? 100 : 0, ustawienia.gazOdwracany ? 0 : 100);
    procentGazu = constrain(procentGazu, 0, 100);
    
    int wartoscSprzeglaADC = analogRead(POT_SPRZEGLO);
    int procentSprzegla = map(wartoscSprzeglaADC, 0, 4095, ustawienia.sprzegloOdwracane ? 100 : 0, ustawienia.sprzegloOdwracane ? 0 : 100);
    procentSprzegla = constrain(procentSprzegla, 0, 100);
    
    aktualizujEkranDiagnostyki(procentGazu, procentSprzegla);
  } else if (tryb == TRYB_POWITALNY) {
    obslugaMruganiaNicku();
  }
  delay(5);
}
// ===================================================================================
// CZĘŚĆ 3: GŁÓWNA LOGIKA PROGRAMU (TEST I NAWIGACJA)
// ===================================================================================

void obslugaMenuNawigacja(int kierunek) {
  poprzedniaPozycjaMenu = pozycjaMenu; // ZAPAMIĘTAJ POPRZEDNIĄ POZYCJĘ
  
  if (tryb == TRYB_MENU_ZAWODNIKA) {
    pozycjaMenu = (pozycjaMenu + kierunek + 5) % 5;
    wymusZaktualizowanieMenu = true; // UŻYJ NOWEJ FLAGI
    wyswietlMenuZawodnika();
  } else if (tryb == TRYB_WYBOR_ZAWODNIKA || tryb == TRYB_USUN_ZAWODNIKA) {
    int limit = (tryb == TRYB_WYBOR_ZAWODNIKA) ? liczbaZawodnikow + 1 : liczbaZawodnikow;
    if (limit == 0) return;
    
    int staraPozycjaPrzewijania = pozycjaPrzewijania;
    pozycjaMenu = (pozycjaMenu + kierunek + limit) % limit;

    if (pozycjaMenu < pozycjaPrzewijania) pozycjaPrzewijania = pozycjaMenu;
    if (pozycjaMenu >= pozycjaPrzewijania + WIERSZY_LISTY_ZAWODNIKOW) pozycjaPrzewijania = pozycjaMenu - WIERSZY_LISTY_ZAWODNIKOW + 1;

    if (staraPozycjaPrzewijania == pozycjaPrzewijania) {
        wymusZaktualizowanieMenu = true; // Tylko zmiana kursora, bez przewijania
    } else {
        wymusPelneRysowanie = true; // Było przewijanie, trzeba odrysować całą listę
    }
    
    if(tryb == TRYB_WYBOR_ZAWODNIKA) wyswietlListeZawodnikow(); else wyswietlListeDoUsuniecia();
  }
}

void obslugaMenuNawigacjaPozioma(int kierunek) {
  if (tryb == TRYB_DODAJ_ZAWODNIKA) {
    if (pozycjaKursora < MAX_DLUGOSC_NICKU) {
      indeksZnaku=(indeksZnaku+kierunek+LICZBA_ZNAKOW)%LICZBA_ZNAKOW; wybranyZnak=DOSTEPNE_ZNAKI[indeksZnaku];
    } else { wybranyZnak = (wybranyZnak == 'Z') ? 'P' : 'Z'; }
    wyswietlDodawanieZawodnika(nowyNick, pozycjaKursora, wybranyZnak);
  } else if (tryb == TRYB_REKORDY_POTWIERDZENIE_USUNIECIA) {
      pozycjaMenuPotwierdzenia = (kierunek > 0) ? 0 : 1;
      wyswietlPotwierdzenieUsuniecia();
  } else if (tryb == TRYB_USUN_ZAWODNIKA_POTWIERDZENIE) {
      pozycjaMenuPotwierdzenia = (kierunek > 0) ? 1 : 0;
      wyswietlPotwierdzenieUsunieciaZawodnika();
  } else if (tryb == TRYB_USUN_WYNIKI_GOSCIA_POTWIERDZENIE) {
      pozycjaMenuPotwierdzenia = (kierunek > 0) ? 1 : 0;
      wyswietlPotwierdzenieUsunieciaGoscia();
  }
}

void obslugaTestu() {
    wartoscGazu = analogRead(POT_GAZ);
    int pG = map(wartoscGazu, ustawienia.gazMin, ustawienia.gazMax, ustawienia.gazOdwracany ? 100 : 0, ustawienia.gazOdwracany ? 0 : 100);
    pG = constrain(pG, 0, 100);

    int wartoscSprzeglaADC = analogRead(POT_SPRZEGLO);
    int pS = map(wartoscSprzeglaADC, 0, 4095, ustawienia.sprzegloOdwracane ? 100 : 0, ustawienia.sprzegloOdwracane ? 0 : 100);
    pS = constrain(pS, 0, 100);
    
    unsigned long teraz = millis();

    switch(stanTestu){
        case 0: // Czekanie na wciśnięcie sprzęgła
            if (wymusPelneRysowanie) {
              rysujTlo();
              tft.setTextSize(3); tft.setTextColor(ILI9341_YELLOW); 
              tft.setCursor(15, 80); tft.print("WCISNIJ SPRZEGLO");
              tft.setCursor(45, 120); tft.print("I PRZYTRZYMAJ");
              wymusPelneRysowanie = false;
            }
            if (pS >= ustawienia.sprzegloWcisnieteProc) {
                digitalWrite(LED_ZIELONY, HIGH);
                stanTestu = 1; 
                rysujSuwakiTestu(pG, pS);
                wyswietlInfoTestu("TRZYMAJ SPRZEGLO");
                czasStartu = teraz;
                czasFazy = random(ustawienia.ledMinTime, ustawienia.ledMaxTime);
            }
            break;

        case 1: // Oczekiwanie na sygnał do puszczenia sprzęgła
            aktualizujSuwakiTestu(pG, pS);
            if (pS < ustawienia.sprzegloWcisnieteProc - 5){
                stanTestu = 4;
                digitalWrite(LED_ZIELONY, LOW); 
                rysujTlo();
                tft.setTextSize(3);tft.setTextColor(ILI9341_RED);
                tft.setCursor(100, 80);tft.print("TASMA!"); 
                tft.setTextSize(2);tft.setCursor(20, 140);tft.print("Pusciles za wczesnie!");
                zapiszWynik(0, pG, "FALSZART");
            } else if (teraz - czasStartu >= czasFazy) {
                stanTestu = 2;
                digitalWrite(LED_ZIELONY, LOW); 
                rysujSuwakiTestu(pG, pS);
                wyswietlInfoTestu("PUSC SPRZEGLO!!!");
                czasStartu = teraz;
            }
            break;

        case 2: // Oczekiwanie na puszczenie sprzęgła
            aktualizujSuwakiTestu(pG, pS);
            if (pS <= ustawienia.sprzegloPuszczoneProc) {
                czasReakcji = teraz - czasStartu;
                procentGazuWyniku = pG;
                stanTestu = 3; 
                rysujTlo();
                tft.setTextSize(3);tft.setTextColor(ILI9341_GREEN);tft.setCursor(120,20);tft.print("WYNIK");
                tft.setTextSize(2);tft.setTextColor(ILI9341_MAGENTA);tft.setCursor(60,55);tft.print("Zawodnik: ");tft.print(aktualnyZawodnik);
                tft.setTextSize(3);tft.setTextColor(ILI9341_WHITE);tft.setCursor(95,85);tft.print(czasReakcji);tft.print(" ms");
                tft.drawLine(0, 110, 320, 110, ILI9341_RED);
                tft.setTextSize(2);tft.setTextColor(ILI9341_CYAN);tft.setCursor(40,120);tft.print("Najlepszy: ");tft.print(najlepszyWynik);tft.print(" ms");
                tft.setTextSize(1);tft.setCursor(60, 140); tft.print("("); tft.print(najlepszyZawodnik); tft.print(")");
                tft.drawFastHLine(0, 155, 320, ILI9341_DARKGREEN);
                
                if (procentGazuWyniku < 75) {
                    tft.setTextSize(2);tft.setTextColor(ILI9341_RED);tft.setCursor(30,165);tft.print("Malo gazu: ");tft.print(procentGazuWyniku);tft.print("%");
                    zapiszWynik(czasReakcji, procentGazuWyniku, "OK_MALO_GAZU");
                } else {
                    tft.setTextSize(2);tft.setTextColor(ILI9341_YELLOW);tft.setCursor(50,175);tft.print("Poziom gazu: ");tft.print(procentGazuWyniku);tft.print("%");
                    zapiszWynik(czasReakcji, procentGazuWyniku, "OK");
                }
            } else if (teraz - czasStartu > 2000) {
                stanTestu = 4;
                rysujTlo();
                tft.setTextSize(3);tft.setTextColor(ILI9341_RED);tft.setCursor(40,100);tft.print("BRAK REAKCJI!");
                zapiszWynik(2000, pG, "BRAK_REAKCJI");
            }
            break;
    }
    if (stanTestu == 3 || stanTestu == 4){
        tft.setTextSize(1);tft.setTextColor(ILI9341_WHITE);
        tft.setCursor(60, 230); tft.print("START/SET aby powrocic");
    }
}

void obslugaMenuOK() {
  wymusPelneRysowanie = true;
  if (tryb == TRYB_MENU_ZAWODNIKA) {
    switch (pozycjaMenu) {
      case 0: tryb = TRYB_WYBOR_ZAWODNIKA; pozycjaPrzewijania = 0; break;
      case 1: tryb = TRYB_DODAJ_ZAWODNIKA; pozycjaKursora=0; indeksZnaku=0; wybranyZnak=' '; nowyNick=""; break;
      case 2: tryb = TRYB_USUN_ZAWODNIKA; pozycjaPrzewijania = 0; break;
      case 3: aktualnyZawodnik = "GOSC"; tryb = TRYB_POWITALNY; break;
      case 4: tryb = TRYB_POWITALNY; break;
    }
  } else if (tryb == TRYB_WYBOR_ZAWODNIKA) {
    aktualnyZawodnik = (pozycjaMenu == 0) ? "GOSC" : listaZawodnikow[pozycjaMenu-1];
    tryb = TRYB_POWITALNY;
  } else if (tryb == TRYB_USUN_ZAWODNIKA) {
    if (liczbaZawodnikow > 0) {
      indeksZawodnikaDoUsuniecia = pozycjaMenu; tryb = TRYB_USUN_ZAWODNIKA_POTWIERDZENIE;
      pozycjaMenuPotwierdzenia = 1;
    }
  } else if (tryb == TRYB_USUN_ZAWODNIKA_POTWIERDZENIE) {
    if (pozycjaMenuPotwierdzenia == 0) { usunZawodnika(indeksZawodnikaDoUsuniecia); pozycjaMenu=0; pozycjaPrzewijania = 0;}
    tryb = TRYB_USUN_ZAWODNIKA;
  } else if (tryb == TRYB_DODAJ_ZAWODNIKA) {
    if (pozycjaKursora < MAX_DLUGOSC_NICKU) {
      if (nowyNick.length()<=pozycjaKursora) nowyNick+=wybranyZnak; else nowyNick.setCharAt(pozycjaKursora, wybranyZnak);
      pozycjaKursora++;
      if (pozycjaKursora>=MAX_DLUGOSC_NICKU) wybranyZnak='Z'; else { indeksZnaku=0; wybranyZnak=DOSTEPNE_ZNAKI[indeksZnaku]; }
    } else {
      if (wybranyZnak == 'Z') {
        nowyNick.trim(); 
        if(nowyNick.length()>0) { zapiszNowegoZawodnika(nowyNick); aktualnyZawodnik=nowyNick; }
        tryb=TRYB_POWITALNY;
        rysujEkranPowitalny();
      } else {
        tryb=TRYB_MENU_ZAWODNIKA;
      }
    }
  } else if (tryb == TRYB_DIAGNOSTYKA_MENU) {
    switch(pozycjaMenu) {
        case 0: tryb = TRYB_DIAGNOSTYKA_LIVE; break;
        case 1: tryb = TRYB_DIAGNOSTYKA_PROGI; trybEdycjiUstawien = false; break;
        case 2: ustawienia.gazOdwracany = !ustawienia.gazOdwracany; zapiszUstawienia(); wymusPelneRysowanie = false; wyswietlMenuDiagnostyki(); return;
        case 3: ustawienia.sprzegloOdwracane = !ustawienia.sprzegloOdwracane; zapiszUstawienia(); wymusPelneRysowanie = false; wyswietlMenuDiagnostyki(); return;
        case 4: digitalWrite(LED_ZIELONY, HIGH); delay(2000); digitalWrite(LED_ZIELONY, LOW); return;
        case 5: tryb = TRYB_POWITALNY; break;
    }
  } else if (tryb == TRYB_DIAGNOSTYKA_PROGI) {
    trybEdycjiUstawien = !trybEdycjiUstawien;
    if (!trybEdycjiUstawien) zapiszUstawienia();
  } else if(tryb == TRYB_REKORDY) {
    tryb = TRYB_REKORDY_POTWIERDZENIE_USUNIECIA;
    pozycjaMenuPotwierdzenia = 1;
  } else if(tryb == TRYB_REKORDY_POTWIERDZENIE_USUNIECIA) {
    if(pozycjaMenuPotwierdzenia == 0) {
        usunWszystkieRekordy();
    }
    tryb = TRYB_REKORDY;
  } else if (tryb == TRYB_USUN_WYNIKI_GOSCIA) {
    tryb = TRYB_USUN_WYNIKI_GOSCIA_POTWIERDZENIE;
    pozycjaMenuPotwierdzenia = 1;
  } else if (tryb == TRYB_USUN_WYNIKI_GOSCIA_POTWIERDZENIE) {
    if(pozycjaMenuPotwierdzenia == 0) {
        usunWynikiGoscia();
    }
    tryb = TRYB_REKORDY;
  }
  
  switch(tryb) {
      case TRYB_POWITALNY: rysujEkranPowitalny(); break;
      case TRYB_MENU_ZAWODNIKA: wyswietlMenuZawodnika(); break;
      case TRYB_WYBOR_ZAWODNIKA: wyswietlListeZawodnikow(); break;
      case TRYB_DODAJ_ZAWODNIKA: wyswietlDodawanieZawodnika(nowyNick, pozycjaKursora, wybranyZnak); break;
      case TRYB_USUN_ZAWODNIKA: wyswietlListeDoUsuniecia(); break;
      case TRYB_USUN_ZAWODNIKA_POTWIERDZENIE: wyswietlPotwierdzenieUsunieciaZawodnika(); break;
      case TRYB_DIAGNOSTYKA_LIVE: wyswietlEkranDiagnostykiLive(); break;
      case TRYB_DIAGNOSTYKA_PROGI: wyswietlUstawieniaProgow(); break;
      case TRYB_REKORDY: wyswietlEkranRekordow(); break;
      case TRYB_REKORDY_POTWIERDZENIE_USUNIECIA: wyswietlPotwierdzenieUsuniecia(); break;
      case TRYB_USUN_WYNIKI_GOSCIA: wyswietlEkranRekordow(); break;
      case TRYB_USUN_WYNIKI_GOSCIA_POTWIERDZENIE: wyswietlPotwierdzenieUsunieciaGoscia(); break;
  }
}
// ===================================================================================
// CZĘŚĆ 4: MENU DIAGNOSTYKI I USTAWIENIA (EEPROM)
// ===================================================================================

void wczytajUstawienia() {
  EEPROM.get(EEPROM_ADRES_USTAWIEN, ustawienia);
  if (ustawienia.gazMax > 4095 || ustawienia.sprzegloWcisnieteProc > 100 || ustawienia.sprzegloPuszczoneProc >= ustawienia.sprzegloWcisnieteProc || ustawienia.ledMaxTime > 15000 || ustawienia.ledMinTime >= ustawienia.ledMaxTime || (ustawienia.screenRotation != 1 && ustawienia.screenRotation != 3)) {
    ustawienia = Ustawienia();
    zapiszUstawienia();
  }
}

void zapiszUstawienia() {
  EEPROM.put(EEPROM_ADRES_USTAWIEN, ustawienia);
  EEPROM.commit();
}

void wyswietlMenuDiagnostyki() {
  if (wymusPelneRysowanie) {
    rysujTlo();
    tft.setTextSize(3); tft.setTextColor(ILI9341_YELLOW); tft.setCursor(50, 20); tft.print("DIAGNOSTYKA");
    tft.setTextSize(1); tft.setTextColor(ILI9341_CYAN); tft.setCursor(20, 225); tft.print("GORA/DOL: Wybor | OK: Akcja | SET: Powrot");
    
    String opcje[] = { "Podglad na zywo", "Ustawienia", "Odwracanie gazu: ", "Odwracanie sprzegla: ", "Testuj diode", "Powrot" };
    opcje[2] += (ustawienia.gazOdwracany ? "ON" : "OFF");
    opcje[3] += (ustawienia.sprzegloOdwracane ? "ON" : "OFF");

    tft.setTextSize(2);
    for(int i=0; i<6; i++){
      tft.setTextColor(i == pozycjaMenu ? ILI9341_CYAN : ILI9341_WHITE);
      tft.setCursor(20, 70 + i * 25);
      tft.print(opcje[i]);
    }
    wymusPelneRysowanie = false;
    wymusZaktualizowanieMenu = false;
  } else if (wymusZaktualizowanieMenu) {
    String opcje[] = { "Podglad na zywo", "Ustawienia", "Odwracanie gazu: ", "Odwracanie sprzegla: ", "Testuj diode", "Powrot" };
    opcje[2] += (ustawienia.gazOdwracany ? "ON" : "OFF");
    opcje[3] += (ustawienia.sprzegloOdwracane ? "ON" : "OFF");
    
    tft.setTextSize(2);
    tft.setTextColor(ILI9341_WHITE);
    tft.setCursor(20, 70 + poprzedniaPozycjaMenu * 25);
    tft.print(opcje[poprzedniaPozycjaMenu]);

    tft.setTextColor(ILI9341_CYAN);
    tft.setCursor(20, 70 + pozycjaMenu * 25);
    tft.print(opcje[pozycjaMenu]);
    
    wymusZaktualizowanieMenu = false;
  }
}

void obslugaMenuDiagnostyki(int kierunek) {
  poprzedniaPozycjaMenu = pozycjaMenu;
  pozycjaMenu = (pozycjaMenu + kierunek + 6) % 6;
  wymusZaktualizowanieMenu = true;
  wyswietlMenuDiagnostyki();
}

void wyswietlUstawieniaProgow() {
  if (wymusPelneRysowanie) {
    rysujTlo();
    tft.setTextSize(2); tft.setTextColor(ILI9341_YELLOW); tft.setCursor(80, 15); tft.print("USTAWIENIA");
    wymusPelneRysowanie = false;
  }

  String etykiety[] = {"Gaz MIN:", "Gaz MAX:", "Sprzeglo Puszczone:", "Sprzeglo Wcisniete:", "Czas LED MIN:", "Czas LED MAX:", "Orientacja:"};
  String strWartosci[7];
  for(int i=0; i<7; i++) {
    switch(i) {
      case 0: strWartosci[i] = String(ustawienia.gazMin); break;
      case 1: strWartosci[i] = String(ustawienia.gazMax); break;
      case 2: strWartosci[i] = String(ustawienia.sprzegloPuszczoneProc) + "%"; break;
      case 3: strWartosci[i] = String(ustawienia.sprzegloWcisnieteProc) + "%"; break;
      case 4: strWartosci[i] = String(ustawienia.ledMinTime); break;
      case 5: strWartosci[i] = String(ustawienia.ledMaxTime); break;
      case 6: strWartosci[i] = (ustawienia.screenRotation == 1) ? "Pozioma" : "Pozioma (Odw)"; break;
    }
  }

  if (wymusZaktualizowanieMenu && poprzedniaPozycjaMenu != pozycjaMenu) {
    tft.setTextSize(2);
    tft.setTextColor(ILI9341_WHITE);
    tft.setCursor(20, 50 + poprzedniaPozycjaMenu * 25);
    tft.print(etykiety[poprzedniaPozycjaMenu]);
    tft.fillRect(200, 50 + poprzedniaPozycjaMenu * 25, 110, 20, ILI9341_BLACK);
    tft.setCursor(200, 50 + poprzedniaPozycjaMenu * 25);
    tft.print(strWartosci[poprzedniaPozycjaMenu]);
    wymusZaktualizowanieMenu = false;
  }
  
  tft.setTextSize(2);
  for (int i=0; i < 7; i++) {
    bool jestEdytowany = (trybEdycjiUstawien && i == pozycjaMenu);
    tft.setTextColor(i == pozycjaMenu ? (jestEdytowany ? ILI9341_RED : ILI9341_CYAN) : ILI9341_WHITE);
    tft.setCursor(20, 50 + i * 25);
    tft.print(etykiety[i]);
    
    tft.fillRect(200, 50 + i * 25, 110, 20, ILI9341_BLACK);
    tft.setCursor(200, 50 + i * 25);
    tft.print(strWartosci[i]);
  }

  tft.setTextSize(1); tft.setTextColor(ILI9341_CYAN); 
  tft.fillRect(0, 220, tft.width(), 20, ILI9341_BLACK);
  if (trybEdycjiUstawien) {
    tft.setCursor(10, 225); tft.print("G/D: +/- 100 | L/P: +/- 10 | Przytrzymanie: szybciej");
  } else {
    tft.setCursor(10, 225); tft.print("G/D: Wybor | OK: Edytuj | SET: Powrot");
  }
}

void obslugaUstawienProgow(int zmiana) {
  if (!trybEdycjiUstawien) {
      poprzedniaPozycjaMenu = pozycjaMenu;
      pozycjaMenu = (pozycjaMenu + zmiana + 7) % 7;
      wymusZaktualizowanieMenu = true;
      wyswietlUstawieniaProgow();
      return;
  }
  
  long maxWartosc = 4095;
  switch(pozycjaMenu) {
    case 0: ustawienia.gazMin = constrain((long)ustawienia.gazMin + zmiana, 0, maxWartosc); break;
    case 1: ustawienia.gazMax = constrain((long)ustawienia.gazMax + zmiana, 0, maxWartosc); break;
    case 2: ustawienia.sprzegloPuszczoneProc = constrain((long)ustawienia.sprzegloPuszczoneProc + (zmiana/10), 0, 100); break;
    case 3: ustawienia.sprzegloWcisnieteProc = constrain((long)ustawienia.sprzegloWcisnieteProc + (zmiana/10), 0, 100); break;
    case 4: ustawienia.ledMinTime = constrain((long)ustawienia.ledMinTime + zmiana, 0, 15000); break;
    case 5: ustawienia.ledMaxTime = constrain((long)ustawienia.ledMaxTime + zmiana, 0, 15000); break;
    case 6: ustawienia.screenRotation = (ustawienia.screenRotation == 1) ? 3 : 1; tft.setRotation(ustawienia.screenRotation); break;
  }
  wyswietlUstawieniaProgow();
}
// ===================================================================================
// CZĘŚĆ 5: FUNKCJE WYŚWIETLANIA I GRAFIKI
// ===================================================================================

void rysujEkranPowitalny() {
  rysujTlo();
  tft.setTextSize(1);
  tft.setTextColor(ILI9341_DARKGREY);
  tft.setCursor(5, 5);
  tft.print("by Jagooda");
  tft.setCursor(tft.width() - 40, 5);
  tft.print("v.1.7");
  tft.setTextSize(3); tft.setTextColor(ILI9341_YELLOW); tft.setCursor(40, 25); tft.print("TEST REAKCJI");
  tft.drawFastHLine(0, 55, tft.width(), ILI9341_YELLOW);
  tft.setTextSize(1);
  int16_t x1, y1; uint16_t w, h;
  String text = "GooMoo#312";
  tft.getTextBounds(text, 0, 0, &x1, &y1, &w, &h);
  tft.setCursor((tft.width() - w) / 2, 60);
  tft.setTextColor(ILI9341_ORANGE);
  tft.print(text);
  if (najlepszyWynik < 9999) {
    tft.setTextSize(2); tft.setTextColor(ILI9341_GREEN); tft.setCursor(20, 85); tft.print("Rekord: "); tft.print(najlepszyWynik); tft.print(" ms");
    tft.setTextSize(1); tft.setTextColor(ILI9341_GREEN); tft.setCursor(20, 105); tft.print("("); tft.print(najlepszyZawodnik); tft.print(")");
  }
  tft.setTextSize(1); tft.setCursor(tft.width() - 50, 10); tft.setTextColor(sdDostepna ? ILI9341_GREEN : ILI9341_RED); tft.print(sdDostepna ? "SD OK" : "Brak SD");
  tft.setTextSize(2); tft.setTextColor(ILI9341_WHITE); tft.setCursor(80, 200); tft.print("Nacisnij START");
  tft.setTextSize(1); tft.setTextColor(ILI9341_CYAN); 
  tft.setCursor(5, 225); tft.print("OK: Zawodnik | LEWO: Rekordy | SET: Cofnij/Menu");
  czasOstatniegoMigniecia = millis();
  stanMigniecia = true;
  obslugaMruganiaNicku();
}

void aktualizujPasekProcentowy(int y, int procent, uint16_t kolor, int &poprzedniProcent, int x, int w, int h) {
  if (procent == poprzedniProcent) return;

  tft.fillRect(x, y, w, h, ILI9341_BLACK);
  tft.drawRect(x, y, w, h, ILI9341_WHITE);
  
  int szerokoscWypelnienia = map(procent, 0, 100, 0, w - 2);
  
  if (szerokoscWypelnienia > 0) {
    tft.fillRect(x + 1, y + 1, szerokoscWypelnienia, h - 2, kolor);
  }
  
  char buf[8];
  sprintf(buf, "%3d%%", procent);
  
  uint8_t textSize = (h >= 30) ? 2 : 1;
  tft.setTextSize(textSize);
  
  int16_t x1, y1;
  uint16_t text_w, text_h;
  tft.getTextBounds(buf, 0, 0, &x1, &y1, &text_w, &text_h);
  
  int textCursorX = x + (w - text_w) / 2;
  int textCursorY = y + (h - text_h) / 2;
  
  tft.setCursor(textCursorX, textCursorY);
  tft.setTextColor(ILI9341_WHITE);
  tft.print(buf);
  
  poprzedniProcent = procent;
}

void rysujSuwakiTestu(int pG, int pS) {
    rysujTlo();
    tft.setTextSize(2); tft.setTextColor(ILI9341_WHITE);
    tft.setCursor(20, 50); tft.println("GAZ:"); 
    tft.drawRect(20, 80, 280, 30, ILI9341_WHITE);
    tft.setCursor(20, 130); tft.print("SPRZEGLO:");
    tft.drawRect(20, 160, 280, 30, ILI9341_WHITE);
    
    poprzedniGazTest = -1;
    poprzednieSprzegloTest = -1;
    
    aktualizujSuwakiTestu(pG, pS);
}

void aktualizujSuwakiTestu(int pG, int pS) {
    int sG = map(pG, 0, 100, 0, 278); // 280-2 = 278 pikseli wypełnienia
    if (pG != poprzedniGazTest) { 
        int pSz = map(poprzedniGazTest, 0, 100, 0, 278); 
        if (sG > pSz) {
            tft.fillRect(21 + pSz, 81, sG - pSz, 28, ILI9341_RED); 
        } else {
            tft.fillRect(21 + sG, 81, 278 - sG, 28, ILI9341_BLACK); 
        }
        // Wyczyść i narysuj tekst
        tft.fillRect(140, 90, 60, 16, ILI9341_BLACK); 
        tft.setCursor(140, 90); 
        tft.setTextSize(2); 
        tft.setTextColor(ILI9341_WHITE); 
        tft.print(pG); 
        tft.print("%"); 
        poprzedniGazTest = pG;
    }
    
    int sS = map(pS, 0, 100, 0, 278); 
    if (pS != poprzednieSprzegloTest) { 
        int pSz = map(poprzednieSprzegloTest, 0, 100, 0, 278); 
        if (sS > pSz) {
            tft.fillRect(21 + pSz, 161, sS - pSz, 28, ILI9341_GREEN); 
        } else {
            tft.fillRect(21 + sS, 161, 278 - sS, 28, ILI9341_BLACK); 
        }
        // Wyczyść i narysuj tekst
        tft.fillRect(140, 170, 60, 16, ILI9341_BLACK); 
        tft.setCursor(140, 170); 
        tft.setTextSize(2); 
        tft.setTextColor(ILI9341_WHITE); 
        tft.print(pS); 
        tft.print("%"); 
        poprzednieSprzegloTest = pS;
    }
}

void wyswietlInfoTestu(String info) {
    tft.fillRect(0, 210, tft.width(), 30, ILI9341_BLACK);
    tft.setTextSize(2);
    tft.setTextColor(ILI9341_CYAN);
    
    int16_t x1, y1; uint16_t w, h;
    tft.getTextBounds(info, 0, 0, &x1, &y1, &w, &h);
    int16_t x = (tft.width() - w) / 2;
    tft.setCursor(x, 220);
    tft.print(info);
}

void aktualizujEkranDiagnostyki(int pG, int pS) {
    int sG = map(pG, 0, 100, 0, 278); // 280-2 = 278 pikseli wypełnienia
    if (pG != poprzedniGaz) { 
        int pSz = map(poprzedniGaz, 0, 100, 0, 278); 
        if (sG > pSz) {
            tft.fillRect(21 + pSz, 101, sG - pSz, 28, ILI9341_RED); 
        } else {
            tft.fillRect(21 + sG, 101, 278 - sG, 28, ILI9341_BLACK); 
        }
        // Wyczyść i narysuj tekst
        tft.fillRect(140, 110, 60, 16, ILI9341_BLACK); 
        tft.setCursor(140, 110); 
        tft.setTextSize(2); 
        tft.setTextColor(ILI9341_WHITE); 
        tft.print(pG); 
        tft.print("%"); 
        poprzedniGaz = pG;
    }
    
    int sS = map(pS, 0, 100, 0, 278); 
    if (pS != poprzednieSprzeglo) { 
        int pSz = map(poprzednieSprzeglo, 0, 100, 0, 278); 
        if (sS > pSz) {
            tft.fillRect(21 + pSz, 181, sS - pSz, 28, ILI9341_GREEN); 
        } else {
            tft.fillRect(21 + sS, 181, 278 - sS, 28, ILI9341_BLACK); 
        }
        // Wyczyść i narysuj tekst
        tft.fillRect(140, 190, 60, 16, ILI9341_BLACK); 
        tft.setCursor(140, 190); 
        tft.setTextSize(2); 
        tft.setTextColor(ILI9341_WHITE); 
        tft.print(pS); 
        tft.print("%"); 
        poprzednieSprzeglo = pS;
    }
}

void wyswietlLogoStartowe() {
  tft.fillScreen(ILI9341_BLUE);
  tft.drawBitmap(0,0, epd_bitmap_zuzelSmile, 320, 240, ILI9341_BLACK);
  tft.setTextSize(3);tft.setTextColor(ILI9341_ORANGE);tft.setCursor(46, 12);tft.print("GooMoo#312");
  tft.setTextSize(3);tft.setTextColor(ILI9341_GREEN);tft.setCursor(48, 10);tft.print("GooMoo#312");
  tft.setTextSize(3);tft.setTextColor(ILI9341_YELLOW);tft.setCursor(53, 212);tft.print("TRENAZER v1.7");
  tft.setTextSize(3);tft.setTextColor(ILI9341_RED);tft.setCursor(55, 210);tft.print("TRENAZER v1.7");
  delay(3000);
}

void obslugaMruganiaNicku() {
    unsigned long teraz = millis();
    uint16_t kolorNicku;
    unsigned long interwal = stanMigniecia ? 300 : 150;
    kolorNicku = stanMigniecia ? ILI9341_CYAN : ILI9341_BLUE;

    if (teraz - czasOstatniegoMigniecia > interwal) {
        stanMigniecia = !stanMigniecia;
        czasOstatniegoMigniecia = teraz;

        int16_t x1, y1; uint16_t w, h;
        tft.setTextSize(3);
        tft.getTextBounds(aktualnyZawodnik, 0, 0, &x1, &y1, &w, &h);
        int16_t x = (tft.width() - w) / 2;
        int16_t y = 140;
        
        tft.fillRect(x - 5, y, w + 10, h, ILI9341_BLACK);
        tft.setTextColor(kolorNicku);
        tft.setCursor(x, y);
        tft.print(aktualnyZawodnik);
    }
}

void wyswietlEkranDiagnostykiLive() {
  rysujTlo();
  tft.setTextSize(2); tft.setTextColor(ILI9341_YELLOW); tft.setCursor(40, 20); tft.print("DIAGNOSTYKA - LIVE");
  tft.setTextSize(2); tft.setTextColor(ILI9341_WHITE);
  tft.setCursor(20, 70); tft.println("GAZ:"); 
  tft.drawRect(20, 100, 280, 30, ILI9341_WHITE);
  tft.setCursor(20, 150); tft.print("SPRZEGLO:");
  tft.drawRect(20, 180, 280, 30, ILI9341_WHITE);
  tft.setTextSize(1); tft.setTextColor(ILI9341_CYAN); tft.setCursor(100, 225); tft.print("SET: Powrot do menu");
  
  poprzedniGaz = -1;
  poprzednieSprzeglo = -1;
}

void wyswietlEkranRekordow() {
  rysujTlo();
  tft.setTextSize(2); tft.setTextColor(ILI9341_YELLOW); tft.setCursor(90, 10); tft.print("REKORDY");
  tft.setTextSize(1); tft.setTextColor(ILI9341_WHITE); 
  tft.setCursor(10, 220); tft.print("GORA/DOL: przewijanie | OK: Usun wszystko");
  tft.setCursor(10, 230); tft.print("SET: powrot | START: Usun wyniki Goscia");
  odczytajPosortujIWyswietlRekordy();
}

void wyswietlMenuZawodnika() {
  if (wymusPelneRysowanie) {
    rysujTlo();
    tft.setTextSize(3); tft.setTextColor(ILI9341_YELLOW); tft.setCursor(30, 20); tft.print("MENU ZAWODNIKA");
    tft.setTextSize(1); tft.setTextColor(ILI9341_ORANGE); tft.setCursor(20, 230); tft.print("GORA/DOL: wybor | OK: zatwierdz | SET: powrot");
    
    String opcje[] = {"Wybierz", "Dodaj", "Usun", "Gosc", "Powrot"};
    tft.setTextSize(2);
    for(int i=0; i<5; i++){
      tft.setTextColor(i == pozycjaMenu ? ILI9341_CYAN : ILI9341_WHITE);
      tft.setCursor(60, 70 + i * 30);
      tft.print(opcje[i]);
    }
    wymusPelneRysowanie = false;
    wymusZaktualizowanieMenu = false;
  } else if (wymusZaktualizowanieMenu) {
    String opcje[] = {"Wybierz", "Dodaj", "Usun", "Gosc", "Powrot"};
    tft.setTextSize(2);

    tft.setTextColor(ILI9341_WHITE);
    tft.setCursor(60, 70 + poprzedniaPozycjaMenu * 30);
    tft.print(opcje[poprzedniaPozycjaMenu]);

    tft.setTextColor(ILI9341_CYAN);
    tft.setCursor(60, 70 + pozycjaMenu * 30);
    tft.print(opcje[pozycjaMenu]);
    
    wymusZaktualizowanieMenu = false;
  }
}

void wyswietlListeZawodnikow() {
  if (wymusPelneRysowanie) {
    rysujTlo();
    tft.setTextSize(2); tft.setTextColor(ILI9341_YELLOW); tft.setCursor(40, 30); tft.print("WYBIERZ ZAWODNIKA");
    tft.setTextSize(1); tft.setTextColor(ILI9341_CYAN); tft.setCursor(20, 220); tft.print("GORA/DOL: wybor | OK: zatwierdz | SET: powrot");
    wymusPelneRysowanie = false;
  }
  
  tft.fillRect(0, 60, tft.width(), 150, ILI9341_BLACK);
  int sY=65, sp=20; tft.setTextSize(2);

  if (pozycjaPrzewijania > 0) tft.fillTriangle(160, 55, 150, 65, 170, 65, ILI9341_WHITE);
  if (pozycjaPrzewijania + WIERSZY_LISTY_ZAWODNIKOW < liczbaZawodnikow + 1) tft.fillTriangle(160, 210, 150, 200, 170, 200, ILI9341_WHITE);
  
  for(int i=0; i<WIERSZY_LISTY_ZAWODNIKOW; i++){
    int aI = i + pozycjaPrzewijania;
    if (aI > liczbaZawodnikow) break;
    tft.setTextColor(aI == pozycjaMenu ? ILI9341_CYAN : ILI9341_WHITE);
    tft.setCursor(60, sY + i*sp);
    tft.print(aI==0 ? "GOSC" : listaZawodnikow[aI-1]);
  }
}

void wyswietlListeDoUsuniecia() {
  if (wymusPelneRysowanie) {
    rysujTlo();
    tft.setTextSize(2); tft.setTextColor(ILI9341_YELLOW); tft.setCursor(60, 30); tft.print("USUN ZAWODNIKA");
    tft.setTextSize(1); tft.setTextColor(ILI9341_CYAN); tft.setCursor(20, 220); tft.print("GORA/DOL: wybor | OK: usun | SET: powrot");
    wymusPelneRysowanie = false;
  }
  
  tft.fillRect(0, 60, tft.width(), 150, ILI9341_BLACK);
  int sY=65, sp=20; tft.setTextSize(2);

  if (liczbaZawodnikow == 0) { tft.setTextColor(ILI9341_WHITE); tft.setCursor(40, 100); tft.print("Brak zawodnikow!"); return; }

  if (pozycjaPrzewijania > 0) tft.fillTriangle(160, 55, 150, 65, 170, 65, ILI9341_WHITE);
  if (pozycjaPrzewijania + WIERSZY_LISTY_ZAWODNIKOW < liczbaZawodnikow) tft.fillTriangle(160, 210, 150, 200, 170, 200, ILI9341_WHITE);

  for(int i=0; i<WIERSZY_LISTY_ZAWODNIKOW; i++){
      int aI = i + pozycjaPrzewijania;
      if (aI >= liczbaZawodnikow) break;
      tft.setTextColor(aI == pozycjaMenu ? ILI9341_CYAN : ILI9341_WHITE);
      tft.setCursor(60, sY + i*sp);
      tft.print(listaZawodnikow[aI]);
  }
}

void wyswietlDodawanieZawodnika(String aN, int pK, char wZ) {
  if (wymusPelneRysowanie) {
    rysujTlo();
    tft.setTextSize(2); tft.setTextColor(ILI9341_YELLOW); tft.setCursor(40, 30); tft.print("DODAJ ZAWODNIKA");
    tft.setTextSize(1); tft.setTextColor(ILI9341_CYAN); tft.setCursor(20, 220); tft.print("OK: zatwierdz | SET: powrot do menu | START: zapisz i wyjdz");
    wymusPelneRysowanie = false;
  }
  tft.fillRect(30, 80, 280, 20, ILI9341_BLACK);
  tft.setTextSize(2); tft.setTextColor(ILI9341_WHITE); tft.setCursor(40, 80);
  for (int i=0; i<MAX_DLUGOSC_NICKU; i++) {
    if (i < aN.length()) { tft.setTextColor(i == pK ? ILI9341_CYAN : ILI9341_WHITE); tft.print(aN[i]); } 
    else if (i == pK) { tft.setTextColor(ILI9341_CYAN); tft.print(wZ); } 
    else { tft.setTextColor(ILI9341_WHITE); tft.print("_"); }
  }
  tft.fillRect(10, 140, 300, 50, ILI9341_BLACK);
  if (pK >= MAX_DLUGOSC_NICKU) {
    tft.setTextSize(2); tft.setCursor(80, 140);
    tft.setTextColor(wZ == 'Z' ? ILI9341_CYAN : ILI9341_WHITE); tft.print("ZAPISZ");
    tft.setCursor(80, 170); tft.setTextColor(wZ == 'P' ? ILI9341_CYAN : ILI9341_WHITE); tft.print("POWROT");
  } else {
    tft.setTextSize(1); tft.setTextColor(ILI9341_CYAN); tft.setCursor(20, 140); tft.print("LEWO/PRAWO: zmiana znaku | OK: nastepny znak");
    tft.setCursor(80, 160); tft.setTextColor(ILI9341_WHITE);
    for (int i=-2; i<=2; i++) {
      int idx = (indeksZnaku+i+LICZBA_ZNAKOW)%LICZBA_ZNAKOW;
      if (i==0) { tft.setTextColor(ILI9341_CYAN); tft.print("["); tft.print(DOSTEPNE_ZNAKI[idx]); tft.print("]"); tft.setTextColor(ILI9341_WHITE); }
      else { tft.print(" "); tft.print(DOSTEPNE_ZNAKI[idx]); tft.print(" "); }
    }
  }
}

void wyswietlPotwierdzenieUsuniecia() {
  tft.fillRect(40,80,240,80,ILI9341_DARKGREY); tft.drawRect(40,80,240,80,ILI9341_WHITE);
  tft.setTextSize(2); tft.setTextColor(ILI9341_YELLOW); tft.setCursor(65, 100); tft.print("USUNAC WYNIKI?");
  tft.setTextSize(2);
  tft.setTextColor(pozycjaMenuPotwierdzenia == 0 ? ILI9341_CYAN : ILI9341_WHITE); tft.setCursor(70, 130); tft.print("TAK");
  tft.setTextColor(pozycjaMenuPotwierdzenia == 1 ? ILI9341_CYAN : ILI9341_WHITE); tft.setCursor(190, 130); tft.print("NIE");
}

void wyswietlPotwierdzenieUsunieciaZawodnika() {
  tft.fillRect(40, 80, 240, 90, ILI9341_DARKGREY);
  tft.drawRect(40, 80, 240, 90, ILI9341_WHITE);
  tft.setTextSize(2); tft.setTextColor(ILI9341_YELLOW); tft.setCursor(50, 95); tft.print("Usunac gracza?");
  tft.setTextColor(ILI9341_WHITE); tft.setCursor(50, 115); tft.print(listaZawodnikow[indeksZawodnikaDoUsuniecia]);
  tft.setTextSize(2);
  tft.setTextColor(pozycjaMenuPotwierdzenia == 0 ? ILI9341_CYAN : ILI9341_WHITE); tft.setCursor(70, 145); tft.print("TAK");
  tft.setTextColor(pozycjaMenuPotwierdzenia == 1 ? ILI9341_CYAN : ILI9341_WHITE); tft.setCursor(190, 145); tft.print("NIE");
}

void wyswietlPotwierdzenieUsunieciaGoscia() {
  tft.fillRect(40, 80, 240, 90, ILI9341_DARKGREY);
  tft.drawRect(40, 80, 240, 90, ILI9341_WHITE);
  tft.setTextSize(2); tft.setTextColor(ILI9341_YELLOW); tft.setCursor(50, 95); tft.print("Usunac wyniki");
  tft.setCursor(50, 115); tft.print("gracza GOSC?");
  tft.setTextSize(2);
  tft.setTextColor(pozycjaMenuPotwierdzenia == 0 ? ILI9341_CYAN : ILI9341_WHITE); tft.setCursor(70, 145); tft.print("TAK");
  tft.setTextColor(pozycjaMenuPotwierdzenia == 1 ? ILI9341_CYAN : ILI9341_WHITE); tft.setCursor(190, 145); tft.print("NIE");
}

void rysujTlo() {
  uint16_t kolorTla, kolorWzoru;

  // Ustawiamy ciemne tło dla wszystkich ekranów dla lepszej czytelności
  kolorTla = ILI9341_BLACK;

  // Wybieramy kolor wzoru bitmapy w zależności od trybu, aby nadać mu charakter
  // Wzór jest teraz subtelny i ciemny, aby nie rozpraszać.
  switch (tryb) {
    case TRYB_POWITALNY:
      // Stonowany, niebieskawy wzór
      kolorWzoru = ILI9341_NAVY;
      break;

    case TRYB_TEST:
      // Czerwony, "alarmowy" wzór
      kolorWzoru = ILI9341_MAROON;
      break;

    case TRYB_REKORDY:
    case TRYB_MENU_ZAWODNIKA:
    case TRYB_WYBOR_ZAWODNIKA:
    case TRYB_DODAJ_ZAWODNIKA:
    case TRYB_USUN_ZAWODNIKA:
    case TRYB_REKORDY_POTWIERDZENIE_USUNIECIA:
    case TRYB_USUN_ZAWODNIKA_POTWIERDZENIE:
    case TRYB_USUN_WYNIKI_GOSCIA:
    case TRYB_USUN_WYNIKI_GOSCIA_POTWIERDZENIE:
      // Bardzo subtelny, szary wzór dla menu
      kolorWzoru = ILI9341_DARKGREY;
      break;
    
    case TRYB_DIAGNOSTYKA_MENU:
    case TRYB_DIAGNOSTYKA_LIVE:
    case TRYB_DIAGNOSTYKA_PROGI:
      // Zielony, "techniczny" wzór
      kolorWzoru = ILI9341_DARKGREEN;
      break;

    default: // Domyślny schemat
      kolorWzoru = ILI9341_DARKGREY;
      break;
  }

  // Najpierw wypełnij ekran jednolitym, ciemnym kolorem
  tft.fillScreen(kolorTla);
  // Następnie narysuj na nim bitmapę w wybranym, ciemnym kolorze
  tft.drawBitmap(0, 0, epd_bitmap_zuzelSmile, 320, 240, kolorWzoru);
}
// ===================================================================================
// CZĘŚĆ 6: ZARZĄDZANIE DANYMI (KARTA SD I REKORDY)
// ===================================================================================

bool inicjujKarteSD() {
  tft.fillScreen(ILI9341_BLACK);
  tft.setTextSize(2); tft.setTextColor(ILI9341_WHITE);
  tft.setCursor(20, 100); tft.print("Inicjalizacja karty SD...");
  if (!SD.begin(SD_CS)) {
    tft.fillScreen(ILI9341_BLACK); tft.setTextColor(ILI9341_RED);
    tft.setCursor(40, 100); tft.print("Blad karty SD!");
    tft.setCursor(40, 130); tft.print("Kontynuuje bez zapisu.");
    delay(2000);
    return false;
  }
  if (!SD.exists(nazwaPlikuWynikow)) {
    File f=SD.open(nazwaPlikuWynikow, FILE_WRITE);
    if (f) { f.println("Nr,Data,Czas_ms,Gaz_%,Status,Zawodnik"); f.close(); }
  }
  File f=SD.open(nazwaPlikuWynikow, FILE_READ);
  if (f) {
    while (f.available()) {
      if (f.read()=='\n') numerTestu++;
    }
    f.close();
    if (numerTestu>0) numerTestu--;
  }
  tft.fillScreen(ILI9341_BLACK); tft.setTextColor(ILI9341_GREEN);
  tft.setCursor(40, 100); tft.print("Karta SD gotowa!");
  delay(1000);
  return true;
}

void zapiszWynik(unsigned long czas, int poziomGazu, String status) {
  if (!sdDostepna) return;
  numerTestu++;
  File f = SD.open(nazwaPlikuWynikow, FILE_APPEND);
  if (f) {
    String dane = String(numerTestu)+","+String(millis())+","+String(czas)+","+String(poziomGazu)+","+status+","+aktualnyZawodnik;
    f.println(dane);
    f.close();
    if (status.startsWith("OK") && czas > 0 && czas < najlepszyWynik) {
      najlepszyWynik = czas;
      najlepszyZawodnik = aktualnyZawodnik;
    }
  }
}

void wczytajZawodnikow() {
  if (!sdDostepna) return;
  if (!SD.exists(nazwaPlikuZawodnikow)) {
    File f = SD.open(nazwaPlikuZawodnikow, FILE_WRITE);
    if (f) f.close();
    return;
  }
  File f = SD.open(nazwaPlikuZawodnikow, FILE_READ);
  if (f) {
    liczbaZawodnikow = 0;
    while (f.available() && liczbaZawodnikow < MAX_ZAWODNIKOW) {
      String l = f.readStringUntil('\n'); l.trim();
      if (l.length() > 0) listaZawodnikow[liczbaZawodnikow++] = l;
    }
    f.close();
  }
}

void zapiszNowegoZawodnika(String nick) {
  if (!sdDostepna || liczbaZawodnikow >= MAX_ZAWODNIKOW) return;
  for (int i=0; i<liczbaZawodnikow; i++) {
    if (listaZawodnikow[i] == nick) return;
  }
  listaZawodnikow[liczbaZawodnikow++] = nick;
  File f = SD.open(nazwaPlikuZawodnikow, FILE_WRITE);
  if (f) {
    for (int i=0; i<liczbaZawodnikow; i++) f.println(listaZawodnikow[i]);
    f.close();
  }
}

void usunZawodnika(int indeks) {
  if (indeks < 0 || indeks >= liczbaZawodnikow) return;
  String usunietyZawodnik = listaZawodnikow[indeks];
  for (int i = indeks; i < liczbaZawodnikow - 1; i++) {
    listaZawodnikow[i] = listaZawodnikow[i + 1];
  }
  liczbaZawodnikow--;
  File plik = SD.open(nazwaPlikuZawodnikow, FILE_WRITE);
  if (plik) {
    for (int i = 0; i < liczbaZawodnikow; i++) { plik.println(listaZawodnikow[i]); }
    plik.close();
  }
  if (aktualnyZawodnik == usunietyZawodnik) { aktualnyZawodnik = "GOSC"; }
}

void odczytajNajlepszyWynik() {
  najlepszyWynik = 9999;
  najlepszyZawodnik = "---";
  if (!sdDostepna) return;
  File plik = SD.open(nazwaPlikuWynikow, FILE_READ);
  if (!plik) return;
  plik.readStringUntil('\n');
  while (plik.available()) {
    String linia = plik.readStringUntil('\n');
    int p1=linia.indexOf(','),p2=linia.indexOf(',',p1+1),p3=linia.indexOf(',',p2+1),p4=linia.indexOf(',',p3+1),p5=linia.indexOf(',',p4+1);
    if (p5 > 0) {
      String status = linia.substring(p4+1, p5);
      if (status.startsWith("OK")) {
        unsigned long czas = linia.substring(p2+1, p3).toInt();
        if (czas>0 && czas<najlepszyWynik) {
          najlepszyWynik=czas;
          najlepszyZawodnik=linia.substring(p5+1);
        }
      }
    }
  }
  plik.close();
}

void odczytajPosortujIWyswietlRekordy() {
  if (!sdDostepna) { tft.setTextSize(2); tft.setTextColor(ILI9341_RED); tft.setCursor(40, 100); tft.print("Brak karty SD!"); return; }
  File plik = SD.open(nazwaPlikuWynikow, FILE_READ);
  if (!plik) { tft.setTextSize(2); tft.setTextColor(ILI9341_RED); tft.setCursor(40, 100); tft.print("Blad pliku!"); return; }
  
  liczbaWynikow = 0;
  plik.readStringUntil('\n');
  
  while (plik.available() && liczbaWynikow < MAX_WYNIKOW) {
    String linia = plik.readStringUntil('\n'); 
    if (linia.length() > 0) {
      int p1=linia.indexOf(','), p2=linia.indexOf(',',p1+1), p3=linia.indexOf(',',p2+1), p4=linia.indexOf(',',p3+1), p5=linia.indexOf(',',p4+1);
      if (p5 > 0) { 
        String s=linia.substring(p4+1, p5); 
        if(s.startsWith("OK")) { 
          wyniki[liczbaWynikow].czas=linia.substring(p2+1, p3).toInt(); 
          wyniki[liczbaWynikow].nick=linia.substring(p5+1); 
          liczbaWynikow++; 
        } 
      }
    }
  }
  plik.close(); 
  
  // Sortowanie bąbelkowe zoptymalizowane
  for (int i=0; i<liczbaWynikow-1; i++) {
    bool zamiana = false;
    for (int j=0; j<liczbaWynikow-i-1; j++) {
      if (wyniki[j].czas > wyniki[j+1].czas) { 
        Wynik t=wyniki[j]; 
        wyniki[j]=wyniki[j+1]; 
        wyniki[j+1]=t;
        zamiana = true;
      }
    }
    if (!zamiana) break;
  }
  
  tft.fillRect(0, 40, tft.width(), 170, ILI9341_BLACK);
  tft.setTextSize(1); tft.setTextColor(ILI9341_CYAN); tft.setCursor(10,40); tft.print("MIEJSCE");
  tft.setCursor(80,40); tft.print("NICK"); tft.setCursor(240,40); tft.print("WYNIK [ms]");
  if (liczbaWynikow == 0) { tft.setTextSize(2); tft.setTextColor(ILI9341_CYAN); tft.setCursor(70, 100); tft.print("Brak rekordow"); return; }
  
  tft.setTextSize(2); int y = 60;
  for (int i=0; i<WIERSZY_NA_EKRANIE; i++) {
    int idx = i + pozycjaPrzewijania; 
    if (idx >= liczbaWynikow) break;
    tft.setTextColor(ILI9341_WHITE); tft.setCursor(20, y); tft.print(idx+1); tft.print(".");
    tft.setCursor(80, y); tft.print(wyniki[idx].nick); tft.setCursor(240, y); tft.print(wyniki[idx].czas); y+=16;
  }
}

void usunWszystkieRekordy() {
  if (!sdDostepna) return;
  SD.remove(nazwaPlikuWynikow);
  File f = SD.open(nazwaPlikuWynikow, FILE_WRITE);
  if (f) { f.println("Nr,Data,Czas_ms,Gaz_%,Status,Zawodnik"); f.close(); }
  numerTestu = 0; pozycjaPrzewijania=0; liczbaWynikow=0; najlepszyWynik=9999;
  tft.fillRect(50,100,220,40,ILI9341_BLACK); tft.setTextSize(2); tft.setTextColor(ILI9341_RED);
  tft.setCursor(60, 110); tft.print("Rekordy usuniete!"); delay(1500);
  odczytajNajlepszyWynik(); // Odśwież najlepszy wynik
}

void usunWynikiGoscia() {
  if (!sdDostepna) return;
  
  File plik = SD.open(nazwaPlikuWynikow, FILE_READ);
  if (!plik) return;
  
  String trescPliku = "Nr,Data,Czas_ms,Gaz_%,Status,Zawodnik\n";
  String trescTymczasowa = "";
  plik.readStringUntil('\n'); // Pomijamy nagłówek
  
  while (plik.available()) {
    String linia = plik.readStringUntil('\n');
    if (linia.length() > 0) {
      int p5 = linia.lastIndexOf(',');
      if (p5 > 0) {
        String nick = linia.substring(p5+1);
        nick.trim();
        // Usuwamy końce linii jeśli są obecne
        if (nick.endsWith("\r")) nick.remove(nick.length()-1);
        if (nick.endsWith("\n")) nick.remove(nick.length()-1);
        // Zachowujemy tylko wyniki innych niż GOŚĆ
        if (nick != "GOSC" && nick != "GOSC\r" && nick != "GOSC\n") {
          trescTymczasowa += linia;
        }
      }
    }
  }
  plik.close();
  
  SD.remove(nazwaPlikuWynikow);
  File nowyPlik = SD.open(nazwaPlikuWynikow, FILE_WRITE);
  if (nowyPlik) {
    nowyPlik.print(trescPliku);
    nowyPlik.print(trescTymczasowa);
    nowyPlik.close();
  }
  
  numerTestu = 0;
  najlepszyWynik = 9999;
  odczytajNajlepszyWynik();
  liczbaWynikow = 0; // Resetujemy liczbę wyników
  
  tft.fillRect(50,100,220,40,ILI9341_BLACK); tft.setTextSize(2); tft.setTextColor(ILI9341_RED);
  tft.setCursor(60, 110); tft.print("Wyniki Goscia usuniete!"); delay(1500);
  
  // Odśwież wyświetlanie rekordów
  odczytajPosortujIWyswietlRekordy();
}

void obslugaPrzewijaniaRekordow(int kierunek) {
  bool p = false;
  if(kierunek > 0 && pozycjaPrzewijania < liczbaWynikow-WIERSZY_NA_EKRANIE){
    pozycjaPrzewijania++;
    p = true;
  }
  if(kierunek < 0 && pozycjaPrzewijania > 0){
    pozycjaPrzewijania--;
    p = true;
  }
  if(p){
    odczytajPosortujIWyswietlRekordy();
  }
}